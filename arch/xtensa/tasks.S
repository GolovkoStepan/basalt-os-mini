// Переключение задач: сброс окон и смена стека. Только ассемблер.
//
// ПОЧЕМУ ЗДЕСЬ НЕТ НИ ОДНОЙ ФУНКЦИИ C.
//
// Смена указателя стека не терпит пролога: `entry` в начале C-функции уже
// выделил кадр на старом стеке, и после смены a1 этот кадр оказался бы в чужой
// памяти. Поэтому сайт переключения - отдельная функция, и после смены стека в
// ней не остаётся ничего живого.
//
// ПОЧЕМУ СНАЧАЛА СПИЛЛ, А ПОТОМ СМЕНА СТЕКА.
//
// У Xtensa оконный ABI: одновременно живы несколько окон по 16 регистров, и
// регистры вызывающего лежат в физическом файле, а не на стеке. Пока окна не
// сброшены, они принадлежат тому, кто работает сейчас. Поэтому порядок
// строгий: сначала SPILL_ALL_WINDOWS раскладывает живые окна по кадрам на
// стеке задачи, и только потом можно менять стек.
//
// Обратный порядок означал бы сброс окон одной задачи в стек другой. Это не
// гипотеза: та же ошибка, только меньшего размера, уже была на шаге 1 - кадр,
// положенный ниже SP, затёр спилл окон, и падение случалось в одном прогоне
// из трёх.
//
// ПОЧЕМУ СОХРАНЯЮТСЯ ВСЕГО ДВА ЧИСЛА.
//
// В оконном ABI у каждой функции своё окно, и a1 - регистр этого окна. Адрес
// возврата вызывающего уже лежит в его кадре на его стеке (его положил
// `entry`), а регистры сброшены спиллом. Значит контекст задачи - это указатель
// стека и PS. Регистры a0..a15 нашего окна сохранять не нужно: после `retw`
// это окно отбрасывается целиком.
//
// WINDOWSTART НЕ СОХРАНЯЕТСЯ И НЕ ВОССТАНАВЛИВАЕТСЯ - И ЭТО ПРАВИЛЬНО.
//
// Соблазн сохранить его на задачу есть, и он был сделан - после чего плата
// замолкала ровно при возврате. Причина в том, что retw и обработчики
// переполнения/недобора - это единый механизм: спилл оставляет живым одно
// текущее окно, а retw возвращается в окно предка через недобор и восстанавливает
// регистры из его кадра на стеке задачи. Подсовывать сюда готовую маску значит
// обойти механизм, который эти же кадры и обслуживает. FreeRTOS в
// _frxt_dispatch_sol не трогает WINDOWSTART по той же причине.
//
// ЭТАЛОН. Порядок и раскладка кадра взяты из vPortYield и _frxt_dispatch в
// portable/xtensa/portasm.S, спилл - из _xt_context_save в
// components/xtensa/xtensa_context.S. Этот код проверен на этой же плате
// миллионами запусков FreeRTOS; отступать от него в самом опасном месте
// незачем. Отличия от эталона ровно два: нет threadptr (мы его не используем)
// и нет сопроцессоров (их у нас нет).

    .section .iram1.basalt_tasks, "ax", @progbits

// Раскладки, общие с vectors.S: контекст задачи, кадр тика, PS для сброса
// окон. Подключаются, а не дублируются: кадр пишет vectors.S, а возобновляет
// этот файл, и разъехавшиеся смещения дают не ошибку сборки, а мусор в
// регистрах на плате.
#include "task_ctx.h"
#include "xtensa/xt_specreg.h"

// PS на время сброса окон - в task_ctx.h, там же объяснение.

// Возобновить задачу по её контексту. Не возвращается.
//
// Вход: a2 - ctx задачи, в которую надо войти.
//
// Два случая, и различаются они только способом возврата:
//
//   1. задача ещё не начиналась - вход настоящим callx8 (см. комментарий ниже);
//   2. задача остановлена тиком - восстановить кадр тика и `rfi 3`.
//
// Третьего случая - «задача отдала процессор сама» - больше нет, и это главное
// изменение шага 5. Кооперативный кадр убран: `yield` не сохраняет свой стек, а
// просит тик прийти немедленно, и кадр строит тот же код, что при вытеснении.
// Причина, по которой от него отказались: возврат в такой кадр из прерывания
// через `retw` падает на окнах Xtensa, и починить это не удалось (три опыта
// 08.11.2026, подробности - в `basalt_task_preempt` и JOURNAL).
//
// Зовётся только из обработчика тика (по `j`, не вызовом). Вызовом её звать
// нельзя: она меняет стек и не возвращается, а пролог вызова положил бы кадр на
// стек покидаемой задачи.
    .global basalt_task_resume
    .type   basalt_task_resume, @function
    .align  4
basalt_task_resume:
    l32i    a5, a2, CTX_START
    bnez    a5, .Lfirst_entry

    // --- возврат в задачу, остановленную тиком ---
    //
    // Кадр тика - полный: помимо регистров в нём лежат PS, PC и SAR с
    // регистрами циклов. PS уходит в EPS_3, PC - в EPC_3, a0 - в EXCSAVE_3:
    // именно оттуда `rfi 3` их и забирает. Это единственное место, где
    // восстанавливается чужая задача с чужого стека, поэтому порядок жёсткий:
    // сперва спецрегистры, потом регистры окна, и последним a1 - после него
    // кадр недоступен.
    //
    // ОКНА: НИ БАЗУ, НИ МАСКУ НЕ ТРОГАЕМ.
    //
    // WINDOWBASE - не состояние задачи, а свойство текущей глубины вызова.
    // После SPILL_ALL_WINDOWS окна уходящей задачи разложены по её кадрам, база
    // вернулась на прежнее место (16 поворотов - тождество). Регистры входящей
    // задачи мы кладём в ТЕКУЩЕЕ окно, и ей всё равно, какой у базы номер: её
    // кадры на стеке адресуются указателем стека, а не базой.
    //
    // WINDOWSTART - тоже не наше дело, и это проверено дорого. Маска живых
    // окон и кадры на стеке обслуживают друг друга: `retw` и обработчик
    // недобора поднимают регистры предков из кадров, а ссылку на кадр предка
    // обработчик переполнения хранит по [sp-12]. Объявить окно мёртвым
    // (`WINDOWSTART = 1 << базы`, как SET_STACK в IDF) значит заставить `retw`
    // пойти в недобор там, где регистры живы, и прочитать [sp-12]. А в кадре
    // тика это место занято полем TF_A15: кадр покрывает [S-112 .. S), и его
    // верхние 16 байт - та самая область спилла ABI.
    //
    // На плате это выглядело так: причина 28, EXCVADDR 0xFFFFFFE0, сбой в
    // `_WindowUnderflow8` на `l32e a4, a7, -32`, A15 = 0. То есть -32 это
    // ровно 0 - 32: недобор прочитал затёртое поле кадра как ссылку на предка.
    //
    // Отсюда правило: при переключении окна не восстанавливаются вообще.
    // Спилл оставил живым текущее окно, дальше штатно работают `retw` и
    // обработчики недобора. FreeRTOS в `_frxt_dispatch_sol` делает так же.
    l32i    a1, a2, CTX_SP

    l32i    a4, a1, TF_SAR
    wsr     a4, SAR
    l32i    a4, a1, TF_LBEG
    wsr     a4, LBEG
    l32i    a4, a1, TF_LEND
    wsr     a4, LEND
    l32i    a4, a1, TF_LCOUNT
    wsr     a4, LCOUNT

    // PS, PC и a0 задачи - туда, откуда их забирает `rfi 3`: PS в EPS_3,
    // PC в EPC_3, a0 в EXCSAVE_3. Забыть PS нельзя: без него `rfi` возьмёт
    // EPS_3 от прерывания, то есть маску окон и режим УХОДЯЩЕЙ задачи.
    // На плате это выглядит как возврат не в то окно и паника при первом же
    // вызове.
    l32i    a4, a1, TF_A0
    wsr     a4, XT_REG_EXCSAVE_3
    l32i    a4, a1, TF_PS
    wsr     a4, XT_REG_EPS_3
    l32i    a4, a1, TF_PC
    wsr     a4, XT_REG_EPC_3

    l32i    a2, a1, TF_A2
    l32i    a3, a1, TF_A3
    l32i    a4, a1, TF_A4
    l32i    a5, a1, TF_A5
    l32i    a6, a1, TF_A6
    l32i    a7, a1, TF_A7
    l32i    a8, a1, TF_A8
    l32i    a9, a1, TF_A9
    l32i    a10, a1, TF_A10
    l32i    a11, a1, TF_A11
    l32i    a12, a1, TF_A12
    l32i    a13, a1, TF_A13
    l32i    a14, a1, TF_A14
    l32i    a15, a1, TF_A15

    l32i    a1, a1, TF_A1

    // `rsync` перед `rfi` обязателен: без него запись EPS_3/EPC_3 и
    // восстановление регистров могут не вступить в силу до возврата.
    rsync
    rfi     3

    // --- первый вход в задачу ---
    //
    // ПЕРВЫЙ ВХОД В ЗАДАЧУ - НАСТОЯЩИМ callx8.
    //
    // Здесь была ошибка, которая стоила вечера: новую задачу «перепрыгивали»
    // через `jx` в переходник. Это работает ровно до первого вызова внутри
    // задачи. Цепочку звеньев окон строят аппаратура и обработчики
    // переполнения, а указатель стека предка лежит в кадре потомка по
    // смещению -12. При переходе предка нет, и обработчик переполнения пишет
    // регистры по закраске стека (EXCVADDR 0xC3C3C3A3), то есть в никуда.
    //
    // Поэтому стек задачи готовит basalt_task_create - с областью звена, как
    // SET_STACK из xt_instr_macros.h, - а вход делает обычный вызов: он сам
    // поворачивает окно и передаёт вызываемому a9 = a1.
    //
    // Второй заход в тот же тупик - собрать задаче кадр тика заранее и войти
    // через `rfi 3` - тоже проверен и отброшен 09.11.2026. У задачи тогда нет
    // предка, и первый же обработчик переполнения окна читает из `[sp-12]` не
    // указатель кадра, а поле кадра тика: на плате это паника в слоте окна 12
    // с EXCVADDR 0xFFFFFFFA. У вызова предок есть всегда - это переходник.
.Lfirst_entry:
    l32i    a1, a2, CTX_SP
    l32i    a4, a2, CTX_PS

    // Поле OWB в PS не трогаем и маску окон не выставляем: PS восстанавливается
    // как есть, окна не наши. Причины те же, что и в пути возобновления -
    // см. большой комментарий выше. Коротко: `WINDOWSTART = 1 << базы` (рецепт
    // SET_STACK) заставляет `retw` идти в недобор там, где регистры живы, а
    // недобор читает ссылку на кадр предка из [sp-12], то есть из области
    // спилла ABI. Проверено на плате: причина 28, EXCVADDR 0xFFFFFFE0,
    // `_WindowUnderflow8` с A15 = 0.
    //
    // Отметку «ещё не начиналась» снимаем здесь: вход в задачу не возвращается,
    // и C не получит управления, чтобы это сделать.
    movi    a5, 0
    s32i    a5, a2, CTX_START

    // Аргументы вызываемого при callx8 приходят из a10..a15.
    l32i    a10, a2, CTX_ARG
    l32i    a11, a2, CTX_FN
    l32i    a8, a2, CTX_ENTRY

    wsr     a4, PS
    rsync

    mov     a9, a1               // указатель стека для окна вызываемого
    callx8  a8

    // Переходник не возвращается: задача либо отдаёт процессор, либо
    // завершается через basalt_task_exit. Если управление всё же пришло сюда,
    // продолжать нельзя - здесь чужой стек и мёртвое окно.
1:
    j       1b

    .size   basalt_task_resume, . - basalt_task_resume

// Переходник между переключателем и функцией задачи.
//
// Задача - это не «перейти в функцию»: функция вернётся, а возвращаться будет
// некуда. Переходник зовёт функцию задачи, а после её возврата закрывает
// задачу.
//
// Вход: a2 - аргумент, a3 - функция (при call8 аргументы вызывающего уходят в
// a10..a15 и приходят сюда как a2..a7).
    .global basalt_task_trampoline
    .type   basalt_task_trampoline, @function
    .align  4
basalt_task_trampoline:
    // Свой кадр нужен: вошли вызовом, окно повёрнуто.
    //
    // Данные кладём в ПЕРВЫЕ 16 байт кадра. Верхние 16 байт - область, куда
    // аппаратура кладёт регистры вызывающего при переполнении окна; писать
    // туда нельзя даже здесь, где вызывающего нет: она считается её.
    entry   a1, 32
    s32i    a2, a1, 0            // аргумент
    s32i    a3, a1, 4            // функция

    l32i    a10, a1, 0           // аргумент -> a2 вызываемого
    l32i    a8, a1, 4            // функция
    mov     a9, a1               // указатель стека для окна вызываемого
    callx8  a8

    // Функция вернулась - задача закончена. exit не возвращается.
    movi    a10, basalt_task_exit
    mov     a9, a1
    callx8  a10
1:
    j       1b

    .size   basalt_task_trampoline, . - basalt_task_trampoline

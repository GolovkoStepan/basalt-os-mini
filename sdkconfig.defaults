## sdkconfig.defaults
```kconfig
; Конфиг IDF для A0. Смысл: выключить всё, что не нужно голому ядру.
;
; Причины по пунктам:
;   CERTIFICATE_BUNDLE - сборка бандла сертификатов падает на data_file_embed
;       (в пакете framework-espidf нет нужных файлов), а TLS нам не нужен;
;   -Werror на неиспользуемые - свои драйверы пишутся постепенно, и падение
;       сборки из-за ещё не вызванной функции мешает;
;   консоль - UART0 по умолчанию: USB Serial/JTAG занимаем своим драйвером,
;       и чужой вывод в тот же FIFO только путал бы лог.

CONFIG_MBEDTLS_CERTIFICATE_BUNDLE=n
CONFIG_ESP_CONSOLE_UART_DEFAULT=y
CONFIG_COMPILER_WARN_WRITE_STRINGS=n
CONFIG_ESP_SYSTEM_PANIC_PRINT_REBOOT=y

; Свой цикл не отдаёт управление планировщику (его у нас нет), поэтому
; штатный watchdog IDF считает, что IDLE0 завис, и печатает панику раз в
; несколько секунд. На A0 он не нужен: тик у нас свой, а ложные паники
; маскируют настоящие.
CONFIG_ESP_TASK_WDT_EN=n

; PSRAM - 8 МБ Octal на T-Display-S3 (S3R8). Нужна вехе A1: кадровый буфер
; 320x170x2 = 108.8 КБ в SRAM рядом с ядром не помещается, а в PSRAM влезает
; целиком (docs/FUNCTIONALITY.md, раздел 13).
;
; Включение идёт здесь, а не в board-файле: board-файл PlatformIO описывает
; flash и режим загрузки, а PSRAM - это конфиг IDF. До этого CONFIG_SPIRAM не
; был задан вообще, то есть 8 МБ существовали в даташите и были недоступны из
; кода (видно в .pio/build/tdisplay/config/sdkconfig.h).
;
; CONFIG_SPIRAM_IGNORE_NOTFOUND - потому что файл общий на обе espidf-платы,
; а у Cardputer (env:bare, bare-panic) PSRAM физически нет: без этого флага
; esp_psram_chip_init() на её старте делает abort(), то есть плата не
; поднимается вовсе. С флагом она пишет в лог «Failed to init external RAM»
; и работает дальше, как раньше. Когда env:bare уедет в capsh вместе с
; платой, флаг убрать: честнее падать, если PSRAM не нашлась.
;
; Настройки, которые различаются у плат (размер flash), лежат не здесь, а рядом:
; sdkconfig.defaults.tdisplay и sdkconfig.defaults.cardputer. Их подключает
; CMakeLists.txt вторым файлом умолчаний - через platformio.ini это не задать,
; там «;» в списке означает начало комментария.
CONFIG_SPIRAM=y
CONFIG_SPIRAM_MODE_OCT=y
CONFIG_SPIRAM_SPEED_80M=y
CONFIG_SPIRAM_IGNORE_NOTFOUND=y
```

## sdkconfig.defaults.cardputer
```kconfig
; Настройки IDF, которые зависят от платы, - в дополнение к sdkconfig.defaults.
;
; Почему отдельным файлом: PlatformIO передаёт IDF один общий sdkconfig.defaults,
; а размер flash - свойство платы. На Cardputer (M5Stack K132) стоит 8 МБ, на
; T-Display-S3 16 МБ, и общий файл неизбежно врёт про одну из них.
;
; Этот файл нужен не ради самого числа: у Cardputer и сейчас в заголовке 2 МБ.
; Нужен он для честности - когда рядом лежит tdisplay с 16 МБ, «ничего не
; задано» перестаёт быть нейтральным и становится ошибкой чтения.

CONFIG_ESPTOOLPY_FLASHSIZE_8MB=y
```

## sdkconfig.defaults.tdisplay
```kconfig
; Настройки IDF, которые зависят от платы, - в дополнение к sdkconfig.defaults.
;
; Почему отдельным файлом: PlatformIO передаёт IDF один общий sdkconfig.defaults,
; а размер flash - свойство платы. На T-Display-S3 стоит 16 МБ, на Cardputer
; 8 МБ, и общий файл неизбежно врёт про одну из них.
;
; Подключается из CMakeLists.txt вторым файлом умолчаний (IDF умеет список),
; а не через platformio.ini: там разделитель списка «;» - начало комментария,
; и -DSDKCONFIG_DEFAULTS=файл1;файл2 не задать (проверено по
; ~/.platformio/platforms/espressif32/builder/frameworks/espidf.py).
;
; Зачем это вообще нужно, если драйвер flash и так знает про 16 МБ: размер
; отсюда попадает в заголовок образа приложения и в таблицу разделов. При
; неверном числе PlatformIO на каждой сборке пишет
; «Warning! Flash memory size mismatch detected. Expected 16MB, found 2MB!»,
; а в заголовке образа стоит 2 МБ - то есть заявленный размер flash меньше
; реального, и верить заголовку нельзя.

CONFIG_ESPTOOLPY_FLASHSIZE_16MB=y
```
